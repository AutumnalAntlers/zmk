/*
 * Copyright (c) 2023 The ZMK Contributors
 *
 * SPDX-License-Identifier: MIT
 */

/ {
    behaviors {
        macro_wait_time: macro_control_wait_time {
            compatible = "zmk,macro-control-wait-time";
            label = "MAC_WAIT_TIME";
            #binding-cells = <1>;
        };
    };
};
