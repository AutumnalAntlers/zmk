/*
 * Copyright (c) 2023 The ZMK Contributors
 *
 * SPDX-License-Identifier: MIT
 */

#include <dt-bindings/zmk/keys.h>

/ {
    behaviors {
        adaptive_wait_time: adaptive_control_wait_time {
            compatible = "zmk,adaptive-control-wait-time";
            label = "ADPT_WAIT_TIME";
            #binding-cells = <1>;
        };
    };
};

